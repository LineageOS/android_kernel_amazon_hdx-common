/* Copyright (c) 2013, The Linux Foundation. All rights reserved.
 *
 * This program is free software; you can redistribute it and/or modify
 * it under the terms of the GNU General Public License version 2 and
 * only version 2 as published by the Free Software Foundation.
 *
 * This program is distributed in the hope that it will be useful,
 * but WITHOUT ANY WARRANTY; without even the implied warranty of
 * MERCHANTABILITY or FITNESS FOR A PARTICULAR PURPOSE.  See the
 * GNU General Public License for more details.
 */

&mdss_mdp {

	dsi_novatek_1080p_video: qcom,mdss_dsi_novatek_1080p_video {
		qcom,mdss-dsi-panel-name = "novatek 1080p video mode dsi panel";
		qcom,mdss-dsi-panel-controller = <&mdss_dsi0>;
		qcom,mdss-dsi-panel-type = "dsi_video_mode";
		qcom,mdss-dsi-panel-destination = "display_1";
		qcom,mdss-dsi-panel-framerate = <60>;
		qcom,mdss-dsi-virtual-channel-id = <0>;
		qcom,mdss-dsi-stream = <0>;
		qcom,mdss-dsi-panel-width = <1200>;
		qcom,mdss-dsi-panel-height = <1920>;
		qcom,mdss-dsi-h-front-porch = <32>;
		qcom,mdss-dsi-h-back-porch = <16>;
		qcom,mdss-dsi-h-pulse-width = <24>;
		qcom,mdss-dsi-h-sync-skew = <0>;
		qcom,mdss-dsi-v-back-porch = <25>;
		qcom,mdss-dsi-v-front-porch = <10>;
		qcom,mdss-dsi-v-pulse-width = <2>;
		qcom,mdss-dsi-h-left-border = <0>;
		qcom,mdss-dsi-h-right-border = <0>;
		qcom,mdss-dsi-v-top-border = <0>;
		qcom,mdss-dsi-v-bottom-border = <0>;
		qcom,mdss-dsi-bpp = <24>;
		qcom,mdss-dsi-color-order = "rgb_swap_rgb";
		qcom,mdss-dsi-underflow-color = <0x00>;
		qcom,mdss-dsi-border-color = <0>;
		qcom,mdss-dsi-h-sync-pulse = <0>;
		qcom,mdss-dsi-traffic-mode = "non_burst_sync_event";
		qcom,mdss-dsi-lane-map = "lane_map_3012";
		qcom,mdss-dsi-bllp-eof-power-mode;
		qcom,mdss-dsi-bllp-power-mode;
		qcom,mdss-dsi-lane-0-state;
		qcom,mdss-dsi-lane-1-state;
		qcom,mdss-dsi-lane-2-state;
		qcom,mdss-dsi-lane-3-state;
		qcom,mdss-dsi-panel-timings = [ef 38 25 00 67 70 29 3c 2c 03
									04 00];
		qcom,mdss-dsi-t-clk-post = <0x03>;
		qcom,mdss-dsi-t-clk-pre = <0x2c>;
		qcom,mdss-dsi-bl-min-level = <1>;
		qcom,mdss-dsi-bl-max-level = <255>;
		qcom,mdss-dsi-dma-trigger = "trigger_sw"; /* code does not have this but effect is same */
		qcom,mdss-dsi-mdp-trigger = "none";
		qcom,mdss-dsi-bl-pmic-control-type = "bl_ctrl_wled";
		qcom,mdss-dsi-on-command = [32 01 00 00 05 00 02 00 00	/* peripheral on, change the delay from 100 to 5ms */
                                      23 00 00 00 00 00 02 f3 a8 	/* unlock page 8 */
                                      23 00 00 00 00 00 02 7a 2b		/* 0x87a = 2b, this and below relate to garbage screen */
                                      23 00 00 00 00 00 02 7b 63		/* 0x87b = 63 */
                                      23 00 00 00 00 00 02 7c 0d		/* 0x87c = 0d */
                                      23 00 00 00 00 00 02 7e 60		/* 0x87e = 60 */
                                      23 00 00 00 00 00 02 80 00		/* 0x880 = 00 */
                                      23 00 00 00 00 00 02 81 00		/* 0x881 = 00 */
                                      03 01 00 00 01 00 00 	  	/* lock page 8 */
                                      23 00 00 00 00 00 02 f3 a1	/* unlock page 1 */
                                      23 00 00 00 00 00 02 53 80 		/* 0x153 = 80 */
                                      03 01 00 00 01 00 00      ]; 	/* lock page 1 */
		qcom,mdss-dsi-on-command-state = "dsi_lp_mode";
		qcom,mdss-dsi-off-command = [22 01 00 00 05 00 02 00 00];
		qcom,mdss-dsi-off-command-state = "dsi_hs_mode";
		/* no reset requence since no reset pin */
		qcom,mdss-pan-psr-mode;
		qcom,panel-psr-on-cmds = [15 01 00 00 10 00 02 c2 0b
					  15 01 00 00 00 00 02 c2 00];
		qcom,psr-on-cmds-dsi-state = "dsi_hs_mode";
		qcom,panel-psr-off-cmds = [15 01 00 00 00 00 02 c2 03];
		qcom,psr-off-cmds-dsi-state = "dsi_hs_mode";
	};
};
